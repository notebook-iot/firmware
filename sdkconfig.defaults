## sdkconfig.defaults
```kconfig
# Partition Table
CONFIG_PARTITION_TABLE_CUSTOM=y
CONFIG_PARTITION_TABLE_CUSTOM_FILENAME="partitions.csv"

# SSL/TLS Certificate Bundle
CONFIG_MBEDTLS_CRT_BUNDLE_ENABLED=y
CONFIG_MBEDTLS_CRT_BUNDLE_DEFAULT_FULL=y

# SNTP
CONFIG_LWIP_SNTP_MAX_SERVERS=4
```
